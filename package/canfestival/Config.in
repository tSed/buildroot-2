## package/canfestival/Config.in
```kconfig
config BR2_PACKAGE_CANFESTIVAL
	bool "canfestival"
	depends on BR2_i386 || BR2_x86_64 || BR2_powerpc || BR2_arm
	help
	  CanFestival is an OpenSource CANOpen framework, licensed under
	  LGPLv2.1 and GPLv2 for some drivers (virtual_kernel, lincan and
	  copcican_comedi).

	  http://www.canfestival.org

if BR2_PACKAGE_CANFESTIVAL

choice
	prompt "driver"
	default BR2_PACKAGE_CANFESTIVAL_SOCKET

# - AnaGate CAN(duo) driver [1], PeakSystem CAN drive [2] and
#   CO-PCICAN driver [3] are not available (not packaged in Buildroot),
#   so their support are disabled.
# - virtual_kernel driver disabled because it uses very prehistorical
#   kernel APIs, that have been renamed, or marked as deprecated or
#   removed for a long while. The question has been raised on the
#   canfestival mailing list [3].
#
# [1] http://www.anagate.de/en/index.html
# [2] http://www.peak-system.com/linux/
# [3] http://www.cosateq.com/
# [3] http://sourceforge.net/p/canfestival/mailman/message/32519648/

config BR2_PACKAGE_CANFESTIVAL_VIRTUAL
	bool "virtual"
	help
	  Unix pipe based virtual CAN driver.

comment "virtual_kernel driver needs a Linux kernel to be built"
	depends on !BR2_LINUX_KERNEL

config BR2_PACKAGE_CANFESTIVAL_SOCKET
	bool "socket"
	help
	  SocketCAN (the standard mainline CAN bus interface).

	  http://developer.berlios.de/projects/socketcan/

config BR2_PACKAGE_CANFESTIVAL_LINCAN
	bool "lincan"
	help
	  Lincan driver.

	  http://www.ocera.org/download/components/WP7/lincan-0.3.3.html

config BR2_PACKAGE_CANFESTIVAL_CAN4LINUX
	bool "can4linux"
	help
	  Can4linux driver.

	  http://www.port.de/engl/canprod/hw_can4linux.html

config BR2_PACKAGE_CANFESTIVAL_COPCICAN_LINUX
	bool "copcican_linux"
	help
	  User space driver interface for CO-PCICAN card.


config BR2_PACKAGE_CANFESTIVAL_COPCICAN_COMEDI
	bool "copcican_comedi"
	depends on BR2_LINUX_KERNEL
	help
	  COMEDI driver interface for CO-PCICAN card.

	  http://www.cosateq.com/

comment "copcican_comedi driver needs a Linux kernel to be built"
	depends on !BR2_LINUX_KERNEL

endchoice

config BR2_PACKAGE_CANFESTIVAL_DRIVER
	string
	default "anagate_linux"	  if BR2_PACKAGE_CANFESTIVAL_ANAGATE_LINUX
	default "peak_linux"	  if BR2_PACKAGE_CANFESTIVAL_PEAK_LINUX
	default "virtual"	  if BR2_PACKAGE_CANFESTIVAL_VIRTUAL
	default "socket"	  if BR2_PACKAGE_CANFESTIVAL_SOCKET
	default "lincan"	  if BR2_PACKAGE_CANFESTIVAL_LINCAN
	default "can4linux"	  if BR2_PACKAGE_CANFESTIVAL_CAN4LINUX
	default "copcican_linux"  if BR2_PACKAGE_CANFESTIVAL_COPCICAN_LINUX
	default "copcican_comedi" if BR2_PACKAGE_CANFESTIVAL_COPCICAN_COMEDI

config BR2_PACKAGE_CANFESTIVAL_ADDITIONAL_OPTIONS
	string "additional configure options"
	help
	  Additional options can be passed directly to the configure script
	  (e.g.: --MAX_CAN_BUS_ID=..., --SDO_MAX_LENGTH_TRANSFER=...,
	  --SDO_BLOCK_SIZE=...).

config BR2_PACKAGE_CANFESTIVAL_INSTALL_EXAMPLES
	bool "install examples"
	help
	  Install binary application examples.

endif
```

## package/farsight2/Config.in
```kconfig
config BR2_PACKAGE_FARSIGHT2
	bool "farsight"
	depends on BR2_USE_WCHAR # libglib2
	depends on BR2_TOOLCHAIN_HAS_THREADS # libglib2
	depends on BR2_USE_MMU # libglib2
	select BR2_PACKAGE_LIBGLIB2
	select BR2_PACKAGE_LIBNICE
	select BR2_PACKAGE_GSTREAMER
	select BR2_PACKAGE_GST_PLUGINS_BASE
	select BR2_PACKAGE_GST_PLUGINS_GOOD
	select BR2_PACKAGE_GST_PLUGINS_BAD
	help
	  The Farsight (new version named Farstream) project is an effort to
	  create a framework to deal with all known audio/video conferencing
	  protocols. On one side it offers a generic API that makes it possible
	  to write plugins for different streaming protocols, on the other side
	  it offers an API for clients to use those plugins.

	  http://www.freedesktop.org/wiki/Software/Farstream/

comment "farsight2 needs a toolchain w/ wchar, threads"
	depends on BR2_USE_MMU
	depends on !BR2_USE_WCHAR || !BR2_TOOLCHAIN_HAS_THREADS
```

## package/gettext/Config.in
```kconfig
config BR2_PACKAGE_GETTEXT
	bool "gettext"
	depends on BR2_NEEDS_GETTEXT
	depends on BR2_USE_WCHAR
	help
	  The GNU `gettext' utilities are a set of tools that provide a
	  framework to help other GNU packages produce multi-lingual
	  messages.

	  http://www.gnu.org/software/gettext/

comment "gettext requires a toolchain with WCHAR support"
	depends on BR2_NEEDS_GETTEXT && !BR2_USE_WCHAR

comment "libintl requires a toolchain with locale/i18n support"
	depends on BR2_PACKAGE_GETTEXT && !BR2_ENABLE_LOCALE
```

## package/libnice/Config.in
```kconfig
config BR2_PACKAGE_LIBNICE
	bool "libnice"
	depends on BR2_USE_WCHAR # libglib2
	depends on BR2_TOOLCHAIN_HAS_THREADS # libglib2
	depends on BR2_USE_MMU # libglib2
	select BR2_PACKAGE_LIBGLIB2
	help
	  An implementation of the IETF's draft ICE standard (Interactice
	  Connectivity Establishment).

	  http://nice.freedesktop.org/wiki/

comment "libnice needs a toolchain w/ wchar, threads"
	depends on BR2_USE_MMU
	depends on !BR2_USE_WCHAR || !BR2_TOOLCHAIN_HAS_THREADS
```

## package/libsoundtouch/Config.in
```kconfig
config BR2_PACKAGE_LIBSOUNDTOUCH
	bool "libsoundtouch"
	help
	  SoundTouch is an open-source audio processing library for
	  changing the Tempo, Pitch and Playback Rates of audio streams
	  or audio files

	  http://www.surina.net/soundtouch/index.html

config BR2_PACKAGE_LIBSOUNDTOUCH_INTEGER_SAMPLES
	bool "use integer samples instead of floats"
	depends on BR2_PACKAGE_LIBSOUNDTOUCH
```

## package/linux-backports/Config.in
```kconfig
config BR2_PACKAGE_LINUX_BACKPORTS
	bool "linux-backports"
	depends on BR2_LINUX_KERNEL
	help
	  Compatibility driver backports (former compat-wireless).

	  http://wireless.kernel.org/

#
# Configuration selection
#
if BR2_PACKAGE_LINUX_BACKPORTS

choice
	prompt "Backport configuration"
	default BR2_PACKAGE_LINUX_BACKPORTS_USE_DEFCONFIG

config BR2_PACKAGE_LINUX_BACKPORTS_USE_DEFCONFIG
	bool "Using a defconfig"

config BR2_PACKAGE_LINUX_BACKPORTS_USE_CUSTOM_CONFIG
	bool "Using a custom config file"

endchoice

config BR2_PACKAGE_LINUX_BACKPORTS_DEFCONFIG
	string "Defconfig name"
	depends on BR2_PACKAGE_LINUX_BACKPORTS_USE_DEFCONFIG
	help
	  Name of the backports defconfig file to use, without the
	  leading 'defconfig-'.  The defconfig is located in
	  defconfigs/ in the linux-backports tree.

config BR2_PACKAGE_LINUX_BACKPORTS_CUSTOM_CONFIG_FILE
	string "Configuration file path"
	depends on BR2_PACKAGE_LINUX_BACKPORTS_USE_CUSTOM_CONFIG
	help
	  Path to the linux-backports configuration file

endif
```

## package/octomap/Config.in
```kconfig
config BR2_PACKAGE_OCTOMAP
	bool "octomap"
	depends on BR2_INSTALL_LIBSTDCPP
	help
	  The OctoMap library implements a 3D occupancy grid mapping
	  approach, providing data structures and mapping algorithms in
	  C++ particularly suited for robotics.

	  http://octomap.github.io/

config BR2_PACKAGE_OCTOMAP_INSTALL_PROGRAMS
	bool "Install octomap programs in the target"
	depends on BR2_PACKAGE_OCTOMAP

comment "octomap needs a toolchain w/ C++"
	depends on !BR2_INSTALL_LIBSTDCPP
```

## package/openni2/Config.in
```kconfig
config BR2_PACKAGE_OPENNI2
	bool "openni2"
	depends on BR2_PACKAGE_HAS_UDEV
	depends on BR2_INSTALL_LIBSTDCPP
	depends on BR2_TOOLCHAIN_HAS_THREADS # libusb
	select BR2_PACKAGE_LIBUSB
	select BR2_PACKAGE_JPEG
	help
	  The OpenNI2 framework is an open source SDK used for the
	  development of 3D sensing middleware libraries and
	  applications.

	  This package uses the Aldebaran's fork which build a minimal
	  package, providing the OpenNI2 library and the driver for the
	  Asus 3D sensor:
	  https://github.com/aldebaran/openni2

	  http://www.openni.org/

comment "openni2 needs udev and a toolchain w/ C++, threads"
	depends on !BR2_INSTALL_LIBSTDCPP || \
		!BR2_TOOLCHAIN_HAS_THREADS || \
		!BR2_PACKAGE_HAS_UDEV
```

## package/telepathy-farsight/Config.in
```kconfig
config BR2_PACKAGE_TELEPATHY_FARSIGHT
	bool "telepathy-farsight"
	depends on BR2_USE_WCHAR # libglib2
	depends on BR2_TOOLCHAIN_HAS_THREADS # libglib2
	depends on BR2_USE_MMU # libglib2
	select BR2_PACKAGE_LIBGLIB2
	select BR2_PACKAGE_DBUS
	select BR2_PACKAGE_DBUS_GLIB
	select BR2_PACKAGE_FARSIGHT2
	help
	  Farsight connection manager for the Telepathy framework.

	  http://telepathy.freedesktop.org
	  http://telepathy.freedesktop.org/doc/telepathy-farsight/

comment "telepathy-farsight needs a toolchain w/ wchar, threads"
	depends on BR2_USE_MMU
	depends on !BR2_USE_WCHAR || !BR2_TOOLCHAIN_HAS_THREADS
```

## package/telepathy-glib/Config.in
```kconfig
config BR2_PACKAGE_TELEPATHY_GLIB
	bool "telepathy-glib"
	depends on BR2_USE_WCHAR # libglib2
	depends on BR2_TOOLCHAIN_HAS_THREADS # libglib2
	depends on BR2_USE_MMU # libglib2
	select BR2_PACKAGE_LIBGLIB2
	select BR2_PACKAGE_DBUS
	select BR2_PACKAGE_LIBXSLT
	help
	  GLib bindings for the Telepathy D-Bus protocol.

	  http://telepathy.freedesktop.org
	  http://telepathy.freedesktop.org/doc/telepathy-glib/

comment "telepathy-glib needs a toolchain w/ wchar, threads"
	depends on BR2_USE_MMU
	depends on !BR2_USE_WCHAR || !BR2_TOOLCHAIN_HAS_THREADS
```
